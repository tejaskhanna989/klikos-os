## config/kernel_defconfig
```kconfig
# KlikOS Linux Kernel Defconfig
# Minimal config for mobile OS with DRM/KMS, framebuffer, input

CONFIG_ARM64=y
CONFIG_X86_64=y

# General setup
CONFIG_INIT_ENV_ARG_LIMIT=32
CONFIG_CROSS_COMPILE=""
CONFIG_LOCALVERSION="-klikos"
CONFIG_LOCALVERSION_AUTO=y
CONFIG_BUILD_SALT=""
CONFIG_COMPRESSION=""

# IRQ subsystem
CONFIG_GENERIC_IRQ_PROBE=y
CONFIG_GENERIC_IRQ_SHOW=y
CONFIG_GENERIC_IRQ_EFFECTIVE_AFF_MASK=y
CONFIG_GENERIC_IRQ_MIGRATION=y

# Timers subsystem
CONFIG_TICK_ONESHOT=y
CONFIG_NO_HZ_COMMON=y
CONFIG_NO_HZ_IDLE=y
CONFIG_HIGH_RES_TIMERS=y

# CPU/Task time and stats accounting
CONFIG_TICK_CPU_ACCOUNTING=y
CONFIG_BSD_PROCESS_ACCT=y
CONFIG_BSD_PROCESS_ACCT_V3=y
CONFIG_TASKSTATS=y
CONFIG_TASK_DELAY_ACCT=y
CONFIG_TASK_XACCT=y

# RCU Subsystem
CONFIG_TREE_RCU=y
CONFIG_RCU_EXPERT=y
CONFIG_SRCU=y

# Scheduler
CONFIG_FAIR_GROUP_SCHED=y
CONFIG_CFS_BANDWIDTH=y
CONFIG_RT_GROUP_SCHED=y
CONFIG_SCHED_AUTOGROUP=y

# Memory management
CONFIG_MMU=y
CONFIG_SPARSEMEM=y
CONFIG_SPARSEMEM_VMEMMAP=y
CONFIG_HAVE_FAST_GUP=y
CONFIG_ARCH_HAS_CACHE_LINE_SIZE=y
CONFIG_ARCH_HAS_PTE_SPECIAL=y
CONFIG_PROTECT_VMAP=y
CONFIG_PAGETABLE_ISOLATION=y

# Processor type and features
CONFIG_SMP=y
CONFIG_MAX_CPUS=256
CONFIG_NR_CPUS=256
CONFIG_SCHED_MC=y
CONFIG_SCHED_SMT=y

# Power management
CONFIG_PM=y
CONFIG_PM_SLEEP=y
CONFIG_PM_SLEEP_SMP=y
CONFIG_PM_AUTOSLEEP=y
CONFIG_PM_WAKELOCKS=y
CONFIG_PM_WAKELOCKS_LIMIT=100
CONFIG_PM_WAKELOCKS_GC=y

# Driver support
CONFIG_UEVENT_HELPER=y
CONFIG_UEVENT_HELPER_PATH="/sbin/hotplug"
CONFIG_DEVTMPFS=y
CONFIG_DEVTMPFS_MOUNT=y
CONFIG_STANDALONE=y
CONFIG_PREVENT_FIRMWARE_BUILD=y

# Bus options
CONFIG_PCI=y
CONFIG_PCI_DOMAINS=y
CONFIG_PCIEPORTBUS=y

# Device Drivers
CONFIG_DRM=y
CONFIG_DRM_KMS_HELPER=y
CONFIG_DRM_FBDEV_EMULATION=y
CONFIG_DRM_FBDEV_OVERLAP=100
CONFIG_FB=y
CONFIG_FB_CFB_FILLRECT=y
CONFIG_FB_CFB_COPYAREA=y
CONFIG_FB_CFB_IMAGEBLIT=y
CONFIG_FB_MODE_HELPERS=y
CONFIG_FB_TILEBLITTING=y

# Frame buffer hardware drivers
CONFIG_FB_VIRTUAL=y

# Graphics support
CONFIG_VGACON_SOFT_SCROLLBACK=y
CONFIG_DUMMY_CONSOLE=y
CONFIG_DUMMY_CONSOLE_COLUMNS=80
CONFIG_DUMMY_CONSOLE_ROWS=25

# Frame buffer hardware drivers
CONFIG_FB=y

# DRM drivers
CONFIG_DRM_VIRTIO_GPU=y
CONFIG_DRM_PANEL=y

# Input device support
CONFIG_INPUT=y
CONFIG_INPUT_LEDS=y
CONFIG_INPUT_INPUTMAPPER=y
CONFIG_INPUT_EVDEV=y
CONFIG_INPUT_KEYBOARD=y
CONFIG_INPUT_MOUSE=y
CONFIG_INPUT_TOUCHSCREEN=y
CONFIG_INPUT_MISC=y

# Graphics support
CONFIG_AGP=y
CONFIG_VGA_ARB=y
CONFIG_VGA_ARB_MAX_GPUS=16

# Virtualization
CONFIG_VIRT_DRIVERS=y
CONFIG_VIRTIO=y
CONFIG_VIRTIO_PCI=y
CONFIG_VIRTIO_BALLOON=y

# File systems
CONFIG_EXT4_FS=y
CONFIG_EXT4_USE_FOR_EXT2=y
CONFIG_EXT4_FS_POSIX_ACL=y
CONFIG_EXT4_FS_SECURITY=y
CONFIG_FS_POSIX_ACL=y
CONFIG_FILE_LOCKING=y
CONFIG_PROC_FS=y
CONFIG_PROC_SYSCTL=y
CONFIG_TMPFS=y
CONFIG_TMPFS_POSIX_ACL=y
CONFIG_TMPFS_XATTR=y
CONFIG_FS_POSIX_ACL=y

# Networking
CONFIG_NET=y
CONFIG_NET_INGRESS=y
CONFIG_NET_EGRESS=y
CONFIG_SOCK_VALIDATE_XMIT=y
CONFIG_UNIX=y
CONFIG_NET_KEY=y
CONFIG_INET=y
CONFIG_IP_MULTICAST=y
CONFIG_IP_ADVANCED_ROUTER=y
CONFIG_IP_FIB_TRIE_STATS=y
CONFIG_CONNTRACK=y
CONFIG_NETFILTER=y

# Security
CONFIG_KEYS=y
CONFIG_SECURITYFS=y
CONFIG_SECURITY_NETWORK=y
CONFIG_SECURITY_NETWORK_XFRM=y
CONFIG_CRYPTO=y

# Crypto
CONFIG_CRYPTO_ALGAPI=y
CONFIG_CRYPTO_ALGAPI2=y
CONFIG_CRYPTO_AEAD=y
CONFIG_CRYPTO_AEAD2=y
CONFIG_CRYPTO_BLKCIPHER=y
CONFIG_CRYPTO_HASH=y
CONFIG_CRYPTO_HASH2=y
CONFIG_CRYPTO_RNG=y
CONFIG_CRYPTO_AES=y
CONFIG_CRYPTO_ESSIV=y

# Library routines
CONFIG_BITREVERSE=y
CONFIG_CRC32=y

# Console output
CONFIG_VT=y
CONFIG_CONSOLE_TRANSLATIONS=y
CONFIG_VT_CONSOLE=y
CONFIG_HW_CONSOLE=y
CONFIG_VT_HW_CONSOLE_BINDING=y
CONFIG_UNIX98_PTYS=y
CONFIG_DEVPTS_MULTIPLE_INSTANCES=y

CONFIG_PRINTK_TIME=y
CONFIG_ENABLE_MUST_CHECK=y
CONFIG_FRAME_WARN=1024
CONFIG_STRIP_ASM_SYMS=y
CONFIG_READABLE_ASM=y
CONFIG_HEADERS_INSTALL=y

CONFIG_DEBUG_KERNEL=y
CONFIG_DEBUG_MISC=y

CONFIG_DEBUG_KERNEL=y
CONFIG_DEBUG_MISC=y
```

## config/klikos_defconfig
```kconfig
# KlikOS kernel defconfig
# ARM64, QEMU virt target
# Clean-sheet mobile OS — not Android, not Linux

CONFIG_ARCH_AARCH64=y
CONFIG_MACH_VIRT=y
CONFIG_CPU_CORTEX_A72=y
CONFIG_SMP=y
CONFIG_NR_CPUS=4

# Memory
CONFIG_MEMORY_SIZE_MB=1024
CONFIG_KERNEL_LOAD_ADDR=0x40080000
CONFIG_KERNEL_STACK_SIZE=32768

# Drivers
CONFIG_DRIVER_PL011_UART=y
CONFIG_PL011_BASE=0x09000000
CONFIG_PL011_BAUD=115200

# Planned (not yet implemented)
# CONFIG_FRAMEBUFFER=y
# CONFIG_INPUT_TOUCH=y
# CONFIG_STORAGE_EMMC=y
# CONFIG_RTC=y
# CONFIG_GICV2=y
# CONFIG_TIMER_ARM_SP804=y

# Userspace
CONFIG_INIT_PID=1
CONFIG_SHELL=y
CONFIG_DISPLAY_SERVER=y
CONFIG_WINDOW_MANAGER=y
CONFIG_FRAMEWORK=y
CONFIG_RUNTIME=y

# Debug
CONFIG_DEBUG_UART=y
CONFIG_DEBUG_PRINTF=y
```
